## conf/layer.conf
```bitbake
# We might have a conf and classes directory, append to BBPATH
BBPATH .= ":${LAYERDIR}"

# We have a recipes directory, add to BBFILES
BBFILES += "${LAYERDIR}/recipes*/*/*.bb ${LAYERDIR}/recipes*/*/*.bbappend"

BBFILE_COLLECTIONS += "meta-kodi-tucan"
BBFILE_PATTERN_meta-kodi-tucan := "^${LAYERDIR}/"
BBFILE_PRIORITY_meta-kodi-tucan = "8"

LAYERDEPENDS_meta-kodi-tucan = "networking-layer multimedia-layer meta-python core openembedded-layer"
LAYERSERIES_COMPAT_meta-kodi-tucan = "styhead"
```
